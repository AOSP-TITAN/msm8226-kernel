## arch/arm/hotplug/Kconfig
```kconfig
config THUNDERPLUG_QUAD_CONTROL
 	bool "Enable plugging down/up of cores with/without using LCD NOTIFIER"
 	help
This driver doesn't uses LCD NOTIFIER to take down the cpu cores on a device Instead uses simple calculations which are tuned to sit perfectly on a quad core device :).

config ALUCARD_HOTPLUG
	bool "Enable alucard-hotplug cpu hotplug driver"
 	default y
 	help
Generic Alucard-hotplug cpu hotplug driver for ARM SOCs

config MAKO_HOTPLUG
 	bool "Mako Hotplug"
 	default n
 	help
Mako Hotplug: A custom hotplug by fransico franco
```
